/* Real response of the Open-Meteo forecast API for Lima, Peru, captured on
 * 2026-08-18 with the exact query the provider builds in fetch():
 *   https://api.open-meteo.com/v1/forecast?latitude=-12.0464&longitude=-77.0428&...
 *     current=temperature_2m,relative_humidity_2m,dew_point_2m,apparent_temperature,
 *     weather_code,cloud_cover,visibility,surface_pressure,wind_speed_10m,
 *     wind_direction_10m,wind_gusts_10m,is_day
 *     hourly=temperature_2m,cloud_cover,wind_speed_10m,wind_gusts_10m,
 *     precipitation_probability,rain,snowfall,weather_code,is_day
 *     daily=weather_code,temperature_2m_max,temperature_2m_min,sunrise,sunset,
 *     uv_index_max,rain_sum,snowfall_sum,precipitation_probability_max,
 *     wind_speed_10m_max,wind_gusts_10m_max
 *     wind_speed_unit=ms&timezone=auto&timeformat=unixtime&forecast_days=5&forecast_hours=24
 * Timestamps are frozen, expected epochs are hardcoded in the tests.
 *
 * Verbatim response body (24 hourly / 5 daily entries), used as a
 * deterministic parser fixture. GPL-3.0 applies to this file as part of
 * the project.
 */
static const char kOpenMeteoLimaReal[] PROGMEM = R"JSON({"latitude":-12.056238,"longitude":-77.06198,"generationtime_ms":3.1807422637939453,"utc_offset_seconds":-18000,"timezone":"America/Lima","timezone_abbreviation":"GMT-5","elevation":139.0,"current_units":{"time":"unixtime","interval":"seconds","temperature_2m":"°C","relative_humidity_2m":"%","dew_point_2m":"°C","apparent_temperature":"°C","weather_code":"wmo code","cloud_cover":"%","visibility":"m","surface_pressure":"hPa","wind_speed_10m":"m/s","wind_direction_10m":"°","wind_gusts_10m":"m/s","is_day":""},"current":{"time":1787068800,"interval":900,"temperature_2m":21.5,"relative_humidity_2m":60,"dew_point_2m":13.4,"apparent_temperature":20.6,"weather_code":1,"cloud_cover":45,"visibility":2460.00,"surface_pressure":1001.7,"wind_speed_10m":5.81,"wind_direction_10m":153,"wind_gusts_10m":14.50,"is_day":1},"hourly_units":{"time":"unixtime","temperature_2m":"°C","cloud_cover":"%","wind_speed_10m":"m/s","wind_gusts_10m":"m/s","precipitation_probability":"%","rain":"mm","snowfall":"cm","weather_code":"wmo code","is_day":""},"hourly":{"time":[1787068800,1787072400,1787076000,1787079600,1787083200,1787086800,1787090400,1787094000,1787097600,1787101200,1787104800,1787108400,1787112000,1787115600,1787119200,1787122800,1787126400,1787130000,1787133600,1787137200,1787140800,1787144400,1787148000,1787151600],"temperature_2m":[21.5,21.2,21.5,21.2,21.1,20.4,20.0,19.1,18.8,18.3,17.8,17.7,17.5,16.9,16.6,16.9,17.0,17.1,16.8,17.0,17.2,17.7,18.7,19.9],"cloud_cover":[45,39,31,9,6,13,9,23,34,22,17,45,44,45,89,87,99,100,96,66,71,43,34,29],"wind_speed_10m":[5.81,6.08,5.88,5.58,5.33,5.49,5.98,6.23,6.30,6.02,5.52,5.74,5.16,4.37,4.05,3.74,3.12,3.60,3.91,3.89,3.76,3.44,3.89,3.82],"wind_gusts_10m":[14.50,15.20,15.20,14.90,14.10,13.70,14.30,14.70,14.80,14.80,14.20,13.20,13.10,11.60,9.80,9.00,8.30,8.40,9.00,8.90,8.90,8.70,10.00,10.30],"precipitation_probability":[0,0,0,0,0,0,0,0,0,0,0,0,0,0,0,0,0,0,0,0,0,0,0,0],"rain":[0.00,0.00,0.00,0.00,0.00,0.00,0.00,0.00,0.00,0.00,0.00,0.00,0.00,0.00,0.00,0.00,0.00,0.00,0.00,0.00,0.00,0.00,0.00,0.00],"snowfall":[0.00,0.00,0.00,0.00,0.00,0.00,0.00,0.00,0.00,0.00,0.00,0.00,0.00,0.00,0.00,0.00,0.00,0.00,0.00,0.00,0.00,0.00,0.00,0.00],"weather_code":[1,1,1,0,0,0,0,1,1,1,0,1,1,1,3,3,3,3,3,2,2,1,1,1],"is_day":[1,1,1,1,1,1,1,1,0,0,0,0,0,0,0,0,0,0,0,0,1,1,1,1]},"daily_units":{"time":"unixtime","weather_code":"wmo code","temperature_2m_max":"°C","temperature_2m_min":"°C","sunrise":"unixtime","sunset":"unixtime","uv_index_max":"","rain_sum":"mm","snowfall_sum":"cm","precipitation_probability_max":"%","wind_speed_10m_max":"m/s","wind_gusts_10m_max":"m/s"},"daily":{"time":[1787029200,1787115600,1787202000,1787288400,1787374800],"weather_code":[3,3,3,2,3],"temperature_2m_max":[21.5,21.7,21.8,21.9,22.5],"temperature_2m_min":[17.5,16.6,17.0,17.0,17.8],"sunrise":[1787051986,1787138355,1787224722,1787311090,1787397456],"sunset":[1787094257,1787180661,1787267064,1787353466,1787439869],"uv_index_max":[8.45,8.50,8.60,8.65,8.65],"rain_sum":[0.00,0.00,0.00,0.00,0.00],"snowfall_sum":[0.00,0.00,0.00,0.00,0.00],"precipitation_probability_max":[0,0,0,2,0],"wind_speed_10m_max":[6.30,4.60,3.63,3.37,2.98],"wind_gusts_10m_max":[15.20,12.40,10.20,10.00,9.90]}})JSON";
