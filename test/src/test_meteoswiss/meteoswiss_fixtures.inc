/* MeteoSwiss response fixtures used by the parser tests.
 * Captured 2026-08-27 from the MeteoSwiss App and SwissMetNet feeds.
 * Sources: app-prod-ws.meteoswiss-app.ch and data.geo.admin.ch.
 * Source: MeteoSwiss. GPL-3.0, see LICENSE.
 */
static const char kMeteoSwissForecastFixture[] PROGMEM = R"DATA({"currentWeather":{"time":1787818200000,"icon":1,"iconV2":1,"temperature":22.7},"forecast":[{"dayDate":"2026-08-27","iconDay":29,"iconDayV2":29,"temperatureMax":31,"temperatureMin":20,"precipitation":0.5,"precipitationMin":0.5,"precipitationMax":0.5},{"dayDate":"2026-08-28","iconDay":13,"iconDayV2":38,"temperatureMax":24,"temperatureMin":18,"precipitation":15.1,"precipitationMin":5.0,"precipitationMax":30.7},{"dayDate":"2026-08-29","iconDay":2,"iconDayV2":2,"temperatureMax":25,"temperatureMin":16,"precipitation":0.0,"precipitationMin":0.0,"precipitationMax":2.7},{"dayDate":"2026-08-30","iconDay":1,"iconDayV2":1,"temperatureMax":27,"temperatureMin":16,"precipitation":0.0,"precipitationMin":0.0,"precipitationMax":0.2},{"dayDate":"2026-08-31","iconDay":3,"iconDayV2":3,"temperatureMax":24,"temperatureMin":17,"precipitation":0.6,"precipitationMin":0.0,"precipitationMax":6.4},{"dayDate":"2026-09-01","iconDay":26,"iconDayV2":26,"temperatureMax":24,"temperatureMin":14,"precipitation":0.3,"precipitationMin":0.0,"precipitationMax":6.7}],"warnings":[{"warnType":10,"warnLevel":5,"regionId":2600,"text":"More information on measures in force in the cantons to be found on the FOEN Website.","validFrom":1787738460000,"ordering":"a1m1787738460000","htmlText":"More information on measures in force in the cantons to be found on the FOEN Website.","outlook":false,"links":[{"url":"https://www.natural-hazards.ch/home/dealing-with-natural-hazards/forest-fire.html?utm_source=app&utm_medium=referral&utm_campaign=warning#before-forest-fire","text":"General recommendations"},{"url":"https://www.forestfiredanger.ch","text":"© Federal Office for the Environment FOEN"}]}],"warningsOverview":[{"warnType":10,"warnLevel":5}],"graph":{"start":1787781600000,"startLowResolution":1787835600000,"precipitation10m":[0.0,0.0,0.0,0.0,0.0,0.0,0.0,0.0,0.0,0.0,0.0,0.0,0.0,0.0,0.0,0.0,0.0,0.0,0.0,0.0,0.0,0.0,0.0,0.0,0.0,0.0,0.0,0.0,0.0,0.0,0.0,0.0,0.0,0.0,0.0,0.1,0.0,0.0,0.0,1.5,0.5,0.0,0.9,0.0,0.0,0.0,0.0,0.0,0.0,0.0,0.0,0.0,0.0,0.0,0.0,0.0,0.0,0.0,0.0,0.0,0.0,0.0,0.0,0.0,0.0,0.0,0.0,0.0,0.0,0.0,0.0,0.0,0.0,0.0,0.0,0.0,0.0,0.0,0.0,0.0,0.0,0.0,0.0,0.0,0.0,0.0,0.0,0.0,0.0,0.0,0.0,0.0,0.0,0.0,0.0],"precipitationMin10m":[0.0,0.0,0.0,0.0,0.0,0.0,0.0,0.0,0.0,0.0,0.0,0.0,0.0,0.0,0.0,0.0,0.0,0.0,0.0,0.0,0.0,0.0,0.0,0.0,0.0,0.0,0.0,0.0,0.0,0.0,0.0,0.0,0.0,0.0,0.0,0.0,0.0,0.0,0.0,0.0,0.0,0.0,0.0,0.0,0.0,0.0,0.0,0.0,0.0,0.0,0.0,0.0,0.0,0.0,0.0,0.0,0.0,0.0,0.0,0.0,0.0,0.0,0.0,0.0,0.0,0.0,0.0,0.0,0.0,0.0,0.0,0.0,0.0,0.0,0.0,0.0,0.0,0.0,0.0,0.0,0.0,0.0,0.0,0.0,0.0,0.0,0.0,0.0,0.0,0.0,0.0,0.0,0.0,0.0,0.0],"precipitationMax10m":[0.0,0.0,0.0,0.0,0.0,0.0,0.0,0.0,0.0,0.0,0.0,0.0,0.0,0.0,0.0,0.0,0.0,0.0,0.0,0.0,0.0,0.0,0.0,0.0,0.0,0.0,0.0,0.0,0.0,0.0,0.0,0.0,0.0,0.0,0.0,0.1,0.0,0.0,0.0,1.5,0.5,0.0,0.9,0.0,0.0,0.0,0.0,0.0,0.0,0.0,0.0,0.0,0.0,0.0,0.0,0.0,0.0,0.0,0.0,0.0,0.0,0.0,0.0,0.0,0.0,0.0,0.0,0.0,0.0,0.0,0.0,0.0,0.0,0.0,0.0,0.0,0.0,0.0,0.0,0.0,0.0,0.0,0.0,0.0,0.0,0.0,0.0,0.0,0.0,0.0,0.0,0.0,0.0,0.0,0.0],"weatherIcon3h":[102,102,29,2,26,26,3,126,101,101,26,3,24,25,24,124,135,103,2,2,2,26,26,102,102,102,2,1,1,1,2,102,102,102,3,3,3,2,3,103,102,126,26,26,26,26,26,126],"weatherIcon3hV2":[102,102,29,2,26,26,3,126,101,101,26,3,24,25,24,124,135,103,2,2,2,26,26,102,102,102,2,1,1,1,2,102,102,102,3,3,3,2,3,103,102,126,26,26,26,26,26,126],"windDirection3h":[115,196,350,330,58,19,358,123,127,321,298,225,281,282,181,161,155,168,153,156,223,239,255,253,145,126,128,146,228,236,249,183,141,145,193,241,260,273,302,289,138,172,127,198,239,259,263,249],"windSpeed3h":[5.3,4.4,8.0,6.2,6.0,6.3,6.6,4.3,3.8,3.6,3.1,4.1,8.4,9.2,6.4,5.4,4.6,3.6,2.8,3.4,6.3,8.8,8.6,4.2,3.3,3.4,2.9,2.9,4.7,6.5,6.7,3.8,3.6,3.2,3.2,3.6,6.1,8.6,10.2,4.3,2.6,3.1,2.8,3.3,4.6,6.4,6.7,5.2],"sunrise":[1787805471180,1787891950723,1787978430247,1788064909755,1788151389249,1788237868736],"sunset":[1787854558818,1787940843942,1788027128384,1788113412181,1788199695388,1788285977984],"temperatureMin1h":[22.9,22.1,21.3,20.5,20.0,19.7,19.5,19.5,19.5,20.4,21.2,23.0,24.8,26.6,28.2,29.5,30.3,30.6,30.3,29.6,28.5,27.1,25.7,24.3,23.1,22.0,21.1,20.3,19.8,19.5,19.4,19.7,20.2,20.8,21.4,21.8,21.9,21.7,21.3,20.8,20.4,20.0,19.7,19.4,19.2,18.8,18.4,17.9,17.4,16.8,16.1,15.5,14.9,14.5,14.5,15.0,15.8,17.1,18.5,19.9,21.2,22.3,23.1,23.7,24.0,23.9,23.5,22.7,21.7,20.5,19.3,18.1,17.2,16.4,15.7,15.2,14.8,14.7,14.9,15.5,16.5,17.8,19.4,21.1,22.7,24.0,25.0,25.7,26.0,25.9,25.4,24.5,23.3,22.0,20.6,19.4,18.3,17.5,16.8,16.3,16.0,15.9,16.1,16.6,17.2,18.1,19.0,19.9,20.6,21.3,21.8,22.2,22.4,22.4,22.1,21.5,20.7,19.6,18.5,17.4,16.3,15.3,14.4,13.6,13.0,12.7,12.7,13.3,14.3,15.7,17.3,18.7,20.0,20.9,21.4,21.4,21.2,20.6,19.9,19.0,18.1,17.1,16.2,15.4],"temperatureMax1h":[22.9,22.1,21.3,20.5,20.0,19.7,19.5,19.5,19.5,20.4,22.6,24.6,26.7,28.6,30.3,31.5,32.3,32.5,32.2,31.4,30.3,28.9,27.5,26.2,24.9,23.9,23.0,22.2,21.6,21.1,21.0,21.3,21.9,22.9,23.9,24.6,25.0,25.1,24.8,24.2,23.6,22.9,22.2,21.6,21.1,20.6,20.0,19.5,18.9,18.4,17.8,17.2,16.7,16.4,16.4,16.8,17.6,18.7,20.1,21.4,22.7,23.8,24.7,25.4,25.7,25.6,25.2,24.4,23.3,22.0,20.7,19.6,18.6,17.7,17.1,16.7,16.4,16.4,16.6,17.2,18.2,19.4,20.9,22.5,23.9,25.2,26.3,27.0,27.3,27.3,26.9,26.1,24.9,23.6,22.2,21.0,20.0,19.1,18.5,18.0,17.7,17.6,17.9,18.4,19.3,20.6,22.0,23.5,24.8,25.9,26.5,26.8,26.7,26.4,25.7,24.9,23.8,22.7,21.6,20.5,19.4,18.4,17.5,16.6,16.0,15.6,15.7,16.2,17.2,18.6,20.2,21.8,23.3,24.4,25.1,25.4,25.3,24.9,24.2,23.3,22.3,21.2,20.2,19.2],"temperatureMean1h":[22.9,22.1,21.3,20.5,20.0,19.7,19.5,19.5,19.5,20.4,21.9,23.7,25.7,27.5,29.1,30.3,31.1,31.3,31.1,30.3,29.2,27.9,26.5,25.1,23.9,22.8,21.9,21.2,20.6,20.3,20.2,20.5,21.1,22.0,22.8,23.4,23.6,23.5,23.2,22.6,22.1,21.5,21.0,20.5,20.1,19.7,19.2,18.7,18.2,17.6,17.0,16.3,15.8,15.5,15.5,15.9,16.8,18.0,19.3,20.7,22.0,23.1,24.0,24.6,24.9,24.9,24.4,23.6,22.6,21.3,20.0,18.8,17.8,17.0,16.4,15.9,15.6,15.5,15.8,16.4,17.4,18.7,20.3,21.9,23.4,24.7,25.7,26.4,26.7,26.6,26.2,25.3,24.2,22.8,21.4,20.1,19.0,18.2,17.5,17.0,16.8,16.7,16.9,17.4,18.1,19.1,20.1,21.2,22.2,23.1,23.8,24.3,24.4,24.3,23.9,23.2,22.2,21.2,20.1,18.9,17.9,16.8,15.9,15.1,14.5,14.2,14.3,14.9,15.9,17.4,19.0,20.6,22.0,23.0,23.6,23.7,23.4,22.8,21.9,20.9,19.9,18.9,18.0,17.1],"precipitation1h":[0.0,0.0,0.0,0.0,0.0,0.0,0.0,0.0,0.0,0.0,0.0,0.0,0.0,0.0,0.0,0.0,0.0,0.0,0.0,0.0,0.0,0.0,0.0,0.0,0.0,0.0,0.0,0.1,0.0,0.2,0.0,0.2,0.0,0.0,0.0,0.0,0.0,0.0,0.0,0.0,0.0,0.0,0.0,0.0,0.0,0.0,0.0,0.0,0.0,0.0,0.0,0.0,0.0,0.0,0.0,0.0,0.0,0.0,0.0,0.0,0.0,0.0,0.0,0.0,0.0,0.0,0.0,0.0,0.0,0.0,0.0,0.0,0.0,0.0,0.0,0.0,0.0,0.0,0.0,0.0,0.0,0.0,0.0,0.0,0.0,0.0,0.0,0.0,0.0,0.0,0.0,0.0,0.0,0.0,0.0,0.0,0.0,0.0,0.0,0.0,0.0,0.0,0.0,0.0,0.0,0.0,0.0,0.0,0.0,0.0,0.0,0.0,0.0,0.0,0.0,0.0,0.0,0.0,0.0,0.0,0.0,0.0,0.0,0.0,0.0,0.0,0.0,0.0,0.0],"precipitationMin1h":[0.0,0.0,0.0,0.0,0.0,0.0,0.0,0.0,0.0,0.0,0.0,0.0,0.0,0.0,0.0,0.0,0.0,0.0,0.0,0.0,0.0,0.0,0.0,0.0,0.0,0.0,0.0,0.0,0.0,0.0,0.0,0.0,0.0,0.0,0.0,0.0,0.0,0.0,0.0,0.0,0.0,0.0,0.0,0.0,0.0,0.0,0.0,0.0,0.0,0.0,0.0,0.0,0.0,0.0,0.0,0.0,0.0,0.0,0.0,0.0,0.0,0.0,0.0,0.0,0.0,0.0,0.0,0.0,0.0,0.0,0.0,0.0,0.0,0.0,0.0,0.0,0.0,0.0,0.0,0.0,0.0,0.0,0.0,0.0,0.0,0.0,0.0,0.0,0.0,0.0,0.0,0.0,0.0,0.0,0.0,0.0,0.0,0.0,0.0,0.0,0.0,0.0,0.0,0.0,0.0,0.0,0.0,0.0,0.0,0.0,0.0,0.0,0.0,0.0,0.0,0.0,0.0,0.0,0.0,0.0,0.0,0.0,0.0,0.0,0.0,0.0,0.0,0.0,0.0],"precipitationMax1h":[0.0,0.0,0.0,0.0,0.0,0.0,0.0,0.0,0.0,0.0,0.0,0.0,0.0,0.0,0.0,0.0,0.0,0.4,1.9,0.5,0.5,0.3,1.9,9.8,6.0,5.3,4.4,3.3,4.1,4.0,2.1,3.7,2.0,0.9,0.4,0.0,0.0,0.0,0.0,0.0,0.0,0.0,0.0,0.0,0.0,0.0,0.0,0.0,0.0,0.0,0.0,0.0,0.0,0.0,0.0,0.0,0.0,0.0,0.0,0.0,0.0,0.0,0.0,0.0,0.0,0.0,0.0,0.0,0.0,0.0,0.0,0.0,0.0,0.0,0.0,0.0,0.0,0.0,0.0,0.0,0.0,0.0,0.3,0.9,0.8,0.1,0.0,0.0,0.0,0.0,0.0,0.0,0.1,0.2,0.1,0.1,0.1,0.2,0.0,0.0,0.0,0.0,0.0,0.0,0.0,0.0,0.0,0.0,0.0,0.0,0.0,0.0,0.0,0.0,0.0,0.0,0.0,0.0,0.0,0.0,0.0,0.0,0.0,0.3,0.4,0.9,1.0,1.0,0.4],"windSpeed1h":[5.3,3.6,3.5,4.4,5.9,6.4,8.0,9.8,7.8,6.2,6.1,6.0,6.0,6.1,6.2,6.3,6.4,6.4,6.6,5.0,4.4,4.3,3.9,3.8,3.8,3.6,3.5,3.6,3.9,3.7,3.1,3.3,3.1,4.1,4.9,6.2,8.4,9.3,8.7,9.2,7.6,7.8,6.4,6.3,5.7,5.4,5.1,4.8,4.6,4.0,3.5,3.6,3.5,3.0,2.8,2.8,3.3,3.4,4.0,4.8,6.3,6.7,8.4,8.8,9.6,9.2,8.6,7.5,5.4,4.2,3.6,3.1,3.3,3.3,3.4,3.4,3.3,3.5,2.9,2.9,2.7,2.9,2.8,3.7,4.7,5.5,6.0,6.5,7.6,7.9,6.7,6.5,4.9,3.8,3.4,3.3,3.6,3.5,3.8,3.2,3.2,3.6,3.2,3.0,3.5,3.6,4.6,5.5,6.1,7.4,8.8,8.6,9.5,10.1,10.2,8.0,6.0,4.3,4.1,2.9,2.6,2.7,2.9,3.1,2.5,2.8,2.8,3.1,3.6,3.3,3.8,4.1,4.6,5.7,6.5,6.4,7.0,6.8,6.7,5.9,5.2,5.2,4.6,3.6],"windSpeed1hq10":[5.3,3.6,3.5,4.4,5.9,6.4,8.0,9.8,7.8,6.2,4.4,4.6,4.5,4.2,4.1,3.9,3.8,4.2,4.3,3.0,2.5,2.3,2.2,2.0,1.9,1.8,1.7,1.8,1.9,2.0,1.6,1.5,1.6,2.2,2.3,3.3,5.3,5.9,5.2,5.7,4.7,4.3,3.6,3.8,3.3,2.9,2.7,2.6,2.3,2.0,1.8,1.8,1.7,1.6,1.5,1.4,1.6,1.7,2.1,2.5,3.8,4.0,5.2,5.9,6.3,5.8,5.5,4.4,2.9,2.4,1.8,1.7,1.7,1.6,1.6,1.9,1.6,1.8,1.5,1.4,1.4,1.6,1.6,2.0,2.7,3.4,3.8,4.1,4.6,5.3,4.4,3.8,2.9,2.2,1.7,1.8,1.8,1.7,2.0,1.6,1.6,1.8,1.6,1.5,1.8,1.8,2.6,3.0,3.8,4.3,5.6,5.4,6.3,6.4,6.4,5.0,3.6,2.2,2.1,1.4,1.4,1.4,1.5,1.4,1.0,1.2,1.2,1.2,1.7,1.6,1.8,2.1,2.2,2.8,3.2,3.3,3.5,3.4,3.4,3.0,2.4,2.3,2.4,1.6],"windSpeed1hq90":[5.3,3.6,3.5,4.4,5.9,6.4,8.0,9.8,7.8,6.2,9.3,9.1,8.9,9.7,10.2,10.3,10.2,9.9,10.8,8.0,8.6,7.5,7.2,7.1,7.6,7.5,6.3,7.2,7.8,6.7,5.4,6.8,6.1,7.8,9.7,12.2,14.0,15.2,13.8,14.7,13.1,13.6,11.4,10.8,10.1,9.6,8.8,9.0,8.9,7.6,6.3,7.2,6.4,5.9,5.7,5.5,6.5,6.2,7.2,8.2,10.6,11.4,12.9,13.7,15.1,13.6,12.8,11.6,10.0,7.5,6.5,6.1,6.3,6.5,6.4,6.4,6.5,6.2,5.7,6.1,5.2,5.4,5.2,6.8,8.4,8.7,9.8,10.4,11.7,11.8,10.5,10.2,8.7,7.2,6.0,6.3,6.3,6.5,7.4,6.3,6.3,6.8,6.3,6.1,7.1,7.1,9.1,9.9,11.1,12.7,13.2,13.9,14.9,16.1,16.0,12.9,10.5,7.8,7.1,5.4,5.5,5.4,5.5,6.9,6.2,6.4,6.0,6.1,7.7,7.4,8.4,8.4,10.4,11.6,12.3,12.6,13.3,13.4,12.4,12.6,11.2,10.7,9.2,7.9],"gustSpeed1h":[11.0,7.5,7.0,9.4,15.6,15.2,20.6,20.9,19.7,13.9,15.8,15.2,14.1,14.9,16.2,17.4,18.5,17.8,18.7,16.8,13.5,13.2,12.8,12.2,10.4,12.4,14.8,13.9,11.6,12.2,11.3,8.1,6.2,13.8,16.7,21.4,28.1,34.8,39.3,36.6,32.3,26.7,24.6,20.3,19.4,18.3,17.4,18.7,16.6,13.9,9.4,7.4,6.8,5.3,5.0,6.2,4.8,6.0,10.9,16.0,20.0,23.2,24.0,25.7,26.6,24.8,23.7,21.6,16.2,13.5,6.4,5.7,5.7,5.3,4.9,4.6,4.8,4.5,4.3,4.2,4.0,4.1,5.5,13.0,16.2,18.2,19.0,18.8,19.7,20.7,18.9,19.2,17.0,14.2,6.4,8.7,11.9,13.9,13.0,5.9,8.3,9.6,8.3,6.5,6.2,10.4,16.9,18.6,21.0,24.7,26.6,28.2,28.4,29.4,29.2,26.4,22.9,18.8,14.9,8.3,5.4,6.4,5.9,7.6,11.2,8.3,7.1,7.3,9.6,12.1,13.1,13.6,16.1,17.5,18.4,19.5,20.4,21.0,20.8,20.1,19.2,18.0,17.1,15.4],"gustSpeed1hq10":[11.0,7.5,7.0,9.4,15.6,15.2,20.6,20.9,19.7,13.9,9.9,12.6,9.2,10.0,11.3,12.2,12.7,13.1,12.8,11.1,7.9,7.2,6.9,6.9,5.7,7.7,8.1,8.4,6.7,6.7,6.1,4.2,2.8,7.2,9.5,12.0,17.9,23.3,26.7,24.4,20.5,17.4,14.7,12.7,12.7,11.7,10.6,10.7,10.3,8.6,4.9,4.4,4.0,2.8,3.0,3.6,2.7,3.6,6.7,10.4,12.9,14.7,16.5,16.6,17.3,17.2,15.3,14.8,10.3,7.8,3.7,3.2,3.3,3.2,2.9,2.6,2.6,2.3,2.5,2.5,2.5,2.5,3.1,7.8,10.3,11.5,13.1,12.7,13.5,13.2,13.0,12.1,10.3,8.7,3.9,4.1,6.6,8.0,6.2,3.6,4.5,4.4,4.5,3.4,3.6,5.9,10.5,10.8,12.7,15.4,18.1,19.1,19.7,19.3,20.0,17.6,15.2,11.4,9.3,4.9,3.2,3.9,3.5,3.8,6.4,3.9,3.7,3.4,4.9,6.1,7.1,7.9,8.3,9.0,9.8,10.0,10.6,10.2,10.5,11.2,9.7,8.9,8.1,7.7],"gustSpeed1hq90":[11.0,7.5,7.0,9.4,15.6,15.2,20.6,20.9,19.7,13.9,22.8,18.7,20.2,22.0,23.4,24.0,25.5,25.4,25.9,25.1,20.8,20.5,19.0,18.5,17.5,20.7,23.7,22.5,18.2,19.2,18.9,14.9,14.1,22.4,27.5,34.5,42.2,50.4,56.0,51.1,45.0,39.3,36.9,30.9,29.6,27.1,28.3,29.3,24.8,21.4,17.4,12.6,11.3,9.5,9.9,12.5,8.8,10.0,18.2,23.7,29.0,33.6,34.9,35.5,36.3,34.7,33.9,31.4,24.3,20.3,11.0,10.0,8.7,8.4,8.6,8.3,8.7,8.0,7.8,8.0,6.7,7.0,9.4,20.5,23.8,25.9,27.5,26.3,27.5,29.3,26.1,27.5,25.8,21.7,10.4,18.0,19.9,20.1,21.6,9.3,15.7,17.3,14.2,13.3,11.1,17.3,25.2,29.4,31.1,35.9,38.4,39.9,40.6,41.1,41.6,37.0,34.1,26.8,22.0,13.6,10.4,11.2,9.6,13.8,18.1,16.2,13.5,14.4,18.6,20.1,22.3,23.2,27.6,28.3,32.5,33.9,32.4,34.1,34.0,34.2,34.3,30.5,29.6,26.4],"sunshine1h":[0,0,0,0,0,0,0,27,35,44,41,47,48,48,49,54,54,48,40,26,0,0,0,0,0,0,0,0,0,0,0,37,37,34,23,16,9,9,8,7,7,6,5,2,0,0,0,0,0,0,0,0,0,0,0,47,58,56,46,39,36,42,51,53,50,45,33,21,0,0,0,0,0,0,0,0,0,0,0,47,54,60,60,60,60,59,57,57,57,55,51,30,0,0,0,0,0,0,0,0,0,0,0,31,23,16,15,20,22,20,24,32,39,42,39,29,0,0,0,0,0,0,0,0,0,0,0,35,39,43,45,44,39,35,33,33,33,31,25,19,0,0,0,0],"precipitationProbability3h":[0.0,0.0,100.0,0.0,0.0,0.0,0.0,0.0,2.0,2.0,20.0,31.0,53.0,73.0,71.0,67.0,29.0,18.0,8.0,0.0,0.0,0.0,0.0,0.0,0.0,0.0,0.0,0.0,0.0,0.0,2.0,10.0,20.0,18.0,14.0,18.0,18.0,14.0,6.0,4.0,6.0,12.0,8.0,10.0,10.0,8.0,31.0,22.0]},"klimaGraph":{"plz":800100,"start":1722470400000,"temperatureGraphValues":{"abs":[21.7,15.1,11.9,5.6,2.1,2.4,3.0,7.4,11.5,14.3,21.1,19.3,20.3,15.3,10.2,4.9,2.4,0.0,5.4,6.6,11.9,15.6,21.9,23.0],"norm":[19.2,15.0,10.3,5.2,2.0,1.2,2.0,6.1,10.1,14.2,17.8,19.7,19.2,15.0,10.3,5.2,2.0,1.2,2.0,6.1,10.1,14.2,17.8,19.7],"abweichung":[2.5,0.1,1.6,0.4,0.1,1.2,1.0,1.3,1.4,0.1,3.3,-0.4,1.1,0.3,-0.1,-0.3,0.4,-1.2,3.4,0.5,1.8,1.4,4.1,3.3]},"sunshineGraphValues":{"abs":[273.3,130.5,64.8,74.7,51.8,67.8,45.7,143.7,244.3,194.1,292.6,208.4,260.0,127.5,86.8,90.6,48.3,74.5,69.8,174.0,242.1,256.0,270.8,329.2],"norm":[220.2,164.6,106.4,60.3,45.0,56.4,85.3,140.9,178.4,193.7,212.8,235.0,220.2,164.6,106.4,60.3,45.0,56.4,85.3,140.9,178.4,193.7,212.8,235.0],"abweichung":[1.2411444141689374,0.7928311057108142,0.6090225563909774,1.2388059701492538,1.151111111111111,1.202127659574468,0.5357561547479485,1.019872249822569,1.3693946188340806,1.0020650490449148,1.375,0.8868085106382979,1.1807447774750228,0.7746051032806804,0.8157894736842105,1.5024875621890548,1.0733333333333333,1.320921985815603,0.8182883939038686,1.2349183818310858,1.3570627802690582,1.3216313887454827,1.2725563909774436,1.400851063829787]},"precipitationGraphValues":{"abs":[61.2,162.0,100.7,75.7,83.4,127.1,29.9,31.4,44.8,130.7,79.6,171.4,116.1,135.3,86.1,93.8,28.5,42.3,94.8,48.8,12.7,54.1,128.0,46.0],"norm":[123.9,88.7,86.8,80.1,88.8,68.2,63.2,72.0,79.8,127.3,124.0,126.1,123.9,88.7,86.8,80.1,88.8,68.2,63.2,72.0,79.8,127.3,124.0,126.1],"abweichung":[0.4939467312348668,1.826381059751973,1.1601382488479264,0.9450686641697879,0.9391891891891893,1.8636363636363635,0.4731012658227848,0.4361111111111111,0.5614035087719298,1.0267085624509034,0.6419354838709677,1.359238699444885,0.9370460048426149,1.5253664036076664,0.9919354838709677,1.1710362047440699,0.32094594594594594,0.6202346041055717,1.4999999999999998,0.6777777777777777,0.15914786967418545,0.42498036135113904,1.032258064516129,0.36478984932593184]}}})DATA";

/* Retained KLO row from the official SwissMetNet VQHA80.csv feed. */
static const char kMeteoSwissObservationFixture[] PROGMEM = R"DATA(Station/Location;Date;tre200s0;rre150z0;sre000z0;gre000z0;ure200s0;tde200s0;dkl010z0;fu3010z0;fu3010z1;prestas0;pp0qffs0;pp0qnhs0;ppz850s0;ppz700s0;dv1towz0;fu3towz0;fu3towz1;ta1tows0;uretows0;tdetows0
KLO;202608270820;22.40;0.00;10.00;560.00;71.40;17.00;42.00;2.90;8.60;964.80;1013.20;1015.20;-;-;-;-;-;-;-;-
)DATA";

