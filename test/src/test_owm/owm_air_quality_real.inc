/* Captured OpenWeatherMap Air Pollution history response for the pinned
 * QEMU fixture. Fetched for Kyiv on 2026-08-22; tests never go on the network.
 *
 * GPL-3.0, see LICENSE.
 */

static const char kOwmAirQualityReal[] PROGMEM =
    R"JSON({"coord":{"lon":30.4974,"lat":50.4989},"list":[{"main":{"aqi":2},"components":{"co":113.26,"no":0,"no2":1.45,"o3":80.97,"so2":2.89,"pm2_5":4.29,"pm10":5.21,"nh3":2.72},"dt":1787346000},{"main":{"aqi":2},"components":{"co":112.45,"no":0,"no2":1.3,"o3":80.15,"so2":3.06,"pm2_5":4.24,"pm10":5.32,"nh3":2.42},"dt":1787349600},{"main":{"aqi":2},"components":{"co":112.57,"no":0,"no2":1.18,"o3":78.82,"so2":2.84,"pm2_5":4.39,"pm10":5.62,"nh3":2.39},"dt":1787353200},{"main":{"aqi":2},"components":{"co":113.01,"no":0,"no2":1.06,"o3":77.57,"so2":2.52,"pm2_5":4.64,"pm10":6.01,"nh3":2.41},"dt":1787356800},{"main":{"aqi":2},"components":{"co":112.39,"no":0,"no2":0.96,"o3":75.82,"so2":2.2,"pm2_5":4.88,"pm10":6.32,"nh3":2.42},"dt":1787360400},{"main":{"aqi":2},"components":{"co":112.47,"no":0,"no2":0.88,"o3":74.57,"so2":1.89,"pm2_5":5.1,"pm10":6.6,"nh3":2.46},"dt":1787364000},{"main":{"aqi":2},"components":{"co":112.08,"no":0,"no2":0.83,"o3":73.18,"so2":1.58,"pm2_5":5.23,"pm10":6.73,"nh3":2.42},"dt":1787367600},{"main":{"aqi":2},"components":{"co":109.86,"no":0,"no2":0.89,"o3":71.06,"so2":1.32,"pm2_5":5.16,"pm10":6.63,"nh3":2.32},"dt":1787371200},{"main":{"aqi":2},"components":{"co":108.23,"no":0.05,"no2":0.99,"o3":70.2,"so2":1.27,"pm2_5":5.01,"pm10":6.42,"nh3":2.19},"dt":1787374800},{"main":{"aqi":2},"components":{"co":106.64,"no":0.13,"no2":0.95,"o3":72.74,"so2":1.54,"pm2_5":4.8,"pm10":6.12,"nh3":1.97},"dt":1787378400},{"main":{"aqi":2},"components":{"co":105.8,"no":0.16,"no2":0.86,"o3":79.35,"so2":2.28,"pm2_5":4.53,"pm10":5.67,"nh3":1.71},"dt":1787382000},{"main":{"aqi":2},"components":{"co":103.8,"no":0.15,"no2":0.72,"o3":84.33,"so2":2.78,"pm2_5":4.21,"pm10":5.15,"nh3":1.49},"dt":1787385600},{"main":{"aqi":2},"components":{"co":102.02,"no":0.12,"no2":0.62,"o3":89.44,"so2":3.15,"pm2_5":4.01,"pm10":4.85,"nh3":1.24},"dt":1787389200},{"main":{"aqi":3},"components":{"co":101.82,"no":0.1,"no2":0.56,"o3":100.85,"so2":3.46,"pm2_5":3.6,"pm10":4.27,"nh3":0.89},"dt":1787392800},{"main":{"aqi":3},"components":{"co":100.18,"no":0.09,"no2":0.52,"o3":104.11,"so2":3.36,"pm2_5":3.38,"pm10":3.96,"nh3":0.75},"dt":1787396400},{"main":{"aqi":3},"components":{"co":99.27,"no":0.09,"no2":0.54,"o3":104.58,"so2":3.41,"pm2_5":3.48,"pm10":4.05,"nh3":0.74},"dt":1787400000},{"main":{"aqi":3},"components":{"co":100.53,"no":0.09,"no2":0.57,"o3":106.39,"so2":3.29,"pm2_5":3.57,"pm10":4.13,"nh3":0.76},"dt":1787403600},{"main":{"aqi":3},"components":{"co":101.04,"no":0.08,"no2":0.64,"o3":105.78,"so2":3.07,"pm2_5":3.6,"pm10":4.15,"nh3":0.84},"dt":1787407200},{"main":{"aqi":3},"components":{"co":101.94,"no":0.07,"no2":0.77,"o3":103.5,"so2":2.93,"pm2_5":3.72,"pm10":4.32,"nh3":0.99},"dt":1787410800},{"main":{"aqi":2},"components":{"co":104.06,"no":0.04,"no2":0.94,"o3":98.53,"so2":2.57,"pm2_5":3.94,"pm10":4.58,"nh3":1.39},"dt":1787414400},{"main":{"aqi":2},"components":{"co":107.26,"no":0.01,"no2":1.06,"o3":91.89,"so2":2.02,"pm2_5":4.28,"pm10":4.92,"nh3":1.94},"dt":1787418000},{"main":{"aqi":2},"components":{"co":110.92,"no":0,"no2":0.99,"o3":85.92,"so2":1.43,"pm2_5":4.59,"pm10":5.16,"nh3":2.34},"dt":1787421600},{"main":{"aqi":2},"components":{"co":111.25,"no":0,"no2":0.89,"o3":80.07,"so2":0.96,"pm2_5":4.35,"pm10":4.78,"nh3":2.42},"dt":1787425200},{"main":{"aqi":2},"components":{"co":112.05,"no":0,"no2":0.81,"o3":77.42,"so2":0.61,"pm2_5":3.9,"pm10":4.2,"nh3":2.35},"dt":1787428800}]})JSON";
