/* Real response of the Open-Meteo air quality API for Lima, Peru, captured on
 * 2026-08-19 with the exact query the provider builds in fetch():
 *   https://air-quality-api.open-meteo.com/v1/air-quality
 *     ?latitude=-12.0464&longitude=-77.0428
 *     &hourly=pm2_5,carbon_monoxide,nitrogen_dioxide,sulphur_dioxide,ammonia,
 *     nitrogen_monoxide,ozone,pm10
 *     &past_days=1&forecast_days=1&timeformat=unixtime
 * Timestamps are frozen, expected epochs and concentrations are hardcoded in
 * the tests. The missing values in `ammonia` are null in the API response; the
 * deserializer must map them to 0 concentrations.
 *
 * Verbatim response body (48 hourly entries), used as a deterministic parser
 * fixture. GPL-3.0 applies to this file as part of the project.
 */
static const char kOpenMeteoAirQualityReal[] PROGMEM = R"JSON({"latitude":-12.0,"longitude":-77.0,"generationtime_ms":0.2422332763671875,"utc_offset_seconds":0,"timezone":"GMT","timezone_abbreviation":"GMT","elevation":139.0,"hourly_units":{"time":"unixtime","pm2_5":"μg/m³","carbon_monoxide":"μg/m³","nitrogen_dioxide":"μg/m³","sulphur_dioxide":"μg/m³","ammonia":"μg/m³","nitrogen_monoxide":"μg/m³","ozone":"μg/m³","pm10":"μg/m³"},"hourly":{"time":[1787011200,1787014800,1787018400,1787022000,1787025600,1787029200,1787032800,1787036400,1787040000,1787043600,1787047200,1787050800,1787054400,1787058000,1787061600,1787065200,1787068800,1787072400,1787076000,1787079600,1787083200,1787086800,1787090400,1787094000,1787097600,1787101200,1787104800,1787108400,1787112000,1787115600,1787119200,1787122800,1787126400,1787130000,1787133600,1787137200,1787140800,1787144400,1787148000,1787151600,1787155200,1787158800,1787162400,1787166000,1787169600,1787173200,1787176800,1787180400],"pm2_5":[12.3,13.3,16.9,19.3,20.7,20.3,16.5,12.9,10.5,8.7,7.9,7.7,9.3,9.7,9.9,11.8,12.1,12.7,12.1,12.0,12.1,12.3,13.4,14.8,14.8,15.8,15.6,14.0,12.4,11.1,9.6,8.2,7.2,6.7,7.0,7.2,7.6,9.3,9.5,12.7,13.8,14.0,14.1,14.3,14.7,15.1,15.6,16.4],"carbon_monoxide":[364.0,420.0,479.0,522.0,550.0,562.0,528.0,405.0,237.0,123.0,120.0,172.0,212.0,213.0,203.0,192.0,182.0,172.0,172.0,186.0,211.0,248.0,313.0,390.0,432.0,410.0,352.0,301.0,272.0,250.0,222.0,176.0,124.0,98.0,118.0,162.0,200.0,219.0,232.0,241.0,247.0,249.0,254.0,260.0,269.0,289.0,336.0,394.0],"nitrogen_dioxide":[19.7,23.2,28.0,30.9,30.2,27.6,24.9,22.3,19.6,17.5,17.0,17.1,20.0,15.9,10.1,5.6,3.5,2.6,2.4,2.5,3.3,5.0,8.6,13.3,20.3,21.4,22.8,23.0,21.2,18.3,15.0,10.9,6.4,3.7,4.2,6.4,7.9,7.9,7.2,6.3,5.0,3.4,2.5,2.4,3.1,5.2,10.0,16.2],"sulphur_dioxide":[4.7,7.4,11.0,13.3,13.1,11.6,9.9,8.3,6.6,5.5,5.5,6.0,7.0,5.9,4.4,3.1,2.4,1.9,1.7,1.7,1.9,2.2,2.6,3.0,4.0,4.7,5.5,6.0,5.7,4.9,4.2,3.5,2.8,2.4,2.4,2.7,2.9,3.0,3.0,2.9,2.6,2.3,2.0,1.9,2.0,2.2,2.7,3.3],"ammonia":[null,null,null,null,null,null,null,null,null,null,null,null,null,null,null,null,null,null,null,null,null,null,null,null,null,null,null,null,null,null,null,null,null,null,null,null,null,null,null,null,null,null,null,null,null,null,null,null],"nitrogen_monoxide":[0.2,5.2,12.2,17.1,18.7,18.3,16.3,11.7,5.5,1.3,1.1,2.8,4.4,3.8,2.9,2.1,1.6,1.2,1.0,1.1,1.4,1.5,1.1,0.5,0.1,0.1,0.1,0.1,0.1,0.0,0.0,0.0,0.0,0.0,0.1,0.2,0.5,1.2,2.1,2.6,2.3,1.7,1.2,1.3,1.6,1.7,1.4,1.0],"ozone":[34.0,29.0,22.0,17.0,17.0,19.0,22.0,25.0,28.0,30.0,31.0,31.0,32.0,40.0,50.0,58.0,60.0,60.0,59.0,60.0,60.0,59.0,53.0,46.0,36.0,34.0,32.0,31.0,32.0,35.0,38.0,41.0,44.0,46.0,45.0,44.0,43.0,45.0,47.0,50.0,53.0,56.0,58.0,58.0,57.0,54.0,47.0,37.0],"pm10":[58.1,52.2,46.4,45.4,42.8,37.1,26.7,18.4,13.4,11.4,10.9,11.0,12.7,15.0,17.3,51.7,62.9,73.8,75.7,76.1,76.1,73.3,75.0,78.0,65.9,68.2,65.2,46.6,32.8,25.5,20.1,16.2,13.9,13.2,13.7,14.2,13.9,15.9,17.7,53.0,67.8,72.6,72.9,70.5,68.5,67.3,65.9,65.2]}})JSON";
