/* Captured OpenWeatherMap One Call 3.0 response for Zaragoza, Spain.
 *
 * Request shape:
 *   https://api.openweathermap.org/data/3.0/onecall
 *     ?lat=41.6488&lon=-0.8891&lang=en&units=metric&exclude=minutely
 * Captured on 2026-08-23. The response contains three AEMET alerts and is
 * frozen for deterministic offline parser tests. The API key was supplied
 * only as a request parameter and is not present in this fixture.
 *
 * GPL-3.0, see LICENSE.
 */

static const char kOwmZaragozaReal[] PROGMEM =
    R"JSON({"lat":41.6488,"lon":-0.8891,"timezone":"Europe/Madrid","timezone_offset":7200,"current":{"dt":1787482013,"sunrise":1787462415,"sunset":1787511159,"temp":28.74,"feels_like":29.11,"pressure":1016,"humidity":48,"dew_point":16.65,"uvi":6.82,"clouds":14,"visibility":10000,"wind_speed":4.12,"wind_deg":90,"weather":[{"id":801,"main":"Clouds","description":"few clouds","icon":"02d"}]},"hourly":[{"dt":1787479200,"temp":28.95,"feels_like":29.59,"pressure":1016,"humidity":50,"dew_point":17.48,"uvi":5.32,"clouds":14,"visibility":10000,"wind_speed":5.26,"wind_deg":126,"wind_gust":5.3,"weather":[{"id":801,"main":"Clouds","description":"few clouds","icon":"02d"}],"pop":0},{"dt":1787482800,"temp":28.74,"feels_like":29.11,"pressure":1016,"humidity":48,"dew_point":16.65,"uvi":6.82,"clouds":14,"visibility":10000,"wind_speed":5.25,"wind_deg":127,"wind_gust":5.21,"weather":[{"id":801,"main":"Clouds","description":"few clouds","icon":"02d"}],"pop":0},{"dt":1787486400,"temp":29.52,"feels_like":29.96,"pressure":1016,"humidity":47,"dew_point":17.03,"uvi":7.49,"clouds":16,"visibility":10000,"wind_speed":5.01,"wind_deg":119,"wind_gust":5.31,"weather":[{"id":801,"main":"Clouds","description":"few clouds","icon":"02d"}],"pop":0},{"dt":1787490000,"temp":30.32,"feels_like":30.74,"pressure":1015,"humidity":45,"dew_point":17.07,"uvi":6.8,"clouds":8,"visibility":10000,"wind_speed":7.78,"wind_deg":106,"wind_gust":7.77,"weather":[{"id":800,"main":"Clear","description":"clear sky","icon":"01d"}],"pop":0},{"dt":1787493600,"temp":31.57,"feels_like":31.84,"pressure":1014,"humidity":41,"dew_point":16.72,"uvi":5.41,"clouds":9,"visibility":10000,"wind_speed":6.44,"wind_deg":117,"wind_gust":6.97,"weather":[{"id":800,"main":"Clear","description":"clear sky","icon":"01d"}],"pop":0.2},{"dt":1787497200,"temp":32.57,"feels_like":32.38,"pressure":1012,"humidity":36,"dew_point":15.57,"uvi":3.6,"clouds":28,"visibility":10000,"wind_speed":4,"wind_deg":134,"wind_gust":5.22,"weather":[{"id":802,"main":"Clouds","description":"scattered clouds","icon":"03d"}],"pop":0.25},{"dt":1787500800,"temp":29.77,"feels_like":32.4,"pressure":1013,"humidity":60,"dew_point":18.85,"uvi":0.4,"clouds":33,"visibility":10000,"wind_speed":7.64,"wind_deg":78,"wind_gust":9.03,"weather":[{"id":500,"main":"Rain","description":"light rain","icon":"10d"}],"pop":0.68,"rain":{"1h":0.76}},{"dt":1787504400,"temp":27.04,"feels_like":28.92,"pressure":1012,"humidity":70,"dew_point":17.75,"uvi":0.23,"clouds":49,"visibility":10000,"wind_speed":11.6,"wind_deg":58,"wind_gust":14.45,"weather":[{"id":501,"main":"Rain","description":"moderate rain","icon":"10d"}],"pop":0.89,"rain":{"1h":1.52}},{"dt":1787508000,"temp":25.77,"feels_like":25.94,"pressure":1012,"humidity":59,"dew_point":13.75,"uvi":0.15,"clouds":40,"visibility":10000,"wind_speed":12.02,"wind_deg":65,"wind_gust":17.4,"weather":[{"id":500,"main":"Rain","description":"light rain","icon":"10d"}],"pop":1,"rain":{"1h":0.55}},{"dt":1787511600,"temp":24.72,"feels_like":24.84,"pressure":1013,"humidity":61,"dew_point":14.47,"uvi":0,"clouds":19,"visibility":2845,"wind_speed":8.69,"wind_deg":61,"wind_gust":16.12,"weather":[{"id":501,"main":"Rain","description":"moderate rain","icon":"10n"}],"pop":1,"rain":{"1h":1.25}},{"dt":1787515200,"temp":24.4,"feels_like":24.36,"pressure":1014,"humidity":56,"dew_point":14.27,"uvi":0,"clouds":27,"visibility":10000,"wind_speed":6.66,"wind_deg":87,"wind_gust":13.12,"weather":[{"id":500,"main":"Rain","description":"light rain","icon":"10n"}],"pop":1,"rain":{"1h":0.43}},{"dt":1787518800,"temp":23.29,"feels_like":23.24,"pressure":1015,"humidity":60,"dew_point":14.36,"uvi":0,"clouds":17,"visibility":10000,"wind_speed":5.51,"wind_deg":94,"wind_gust":10.37,"weather":[{"id":801,"main":"Clouds","description":"few clouds","icon":"02n"}],"pop":0.8},{"dt":1787522400,"temp":23.13,"feels_like":23.33,"pressure":1015,"humidity":70,"dew_point":16.19,"uvi":0,"clouds":15,"visibility":10000,"wind_speed":5.3,"wind_deg":100,"wind_gust":10.45,"weather":[{"id":500,"main":"Rain","description":"light rain","icon":"10n"}],"pop":1,"rain":{"1h":0.22}},{"dt":1787526000,"temp":23.13,"feels_like":23.46,"pressure":1014,"humidity":75,"dew_point":17.71,"uvi":0,"clouds":20,"visibility":10000,"wind_speed":5.69,"wind_deg":113,"wind_gust":11.13,"weather":[{"id":801,"main":"Clouds","description":"few clouds","icon":"02n"}],"pop":0.8},{"dt":1787529600,"temp":24.78,"feels_like":25.43,"pressure":1014,"humidity":81,"dew_point":18.85,"uvi":0,"clouds":24,"visibility":10000,"wind_speed":5.1,"wind_deg":105,"wind_gust":9.85,"weather":[{"id":500,"main":"Rain","description":"light rain","icon":"10n"}],"pop":1,"rain":{"1h":0.16}},{"dt":1787533200,"temp":24.97,"feels_like":25.77,"pressure":1013,"humidity":86,"dew_point":19.63,"uvi":0,"clouds":36,"visibility":10000,"wind_speed":5.01,"wind_deg":102,"wind_gust":8.43,"weather":[{"id":500,"main":"Rain","description":"light rain","icon":"10n"}],"pop":0.4,"rain":{"1h":0.1}},{"dt":1787536800,"temp":24.67,"feels_like":25.54,"pressure":1013,"humidity":90,"dew_point":20.25,"uvi":0,"clouds":35,"visibility":10000,"wind_speed":4.88,"wind_deg":99,"wind_gust":7.88,"weather":[{"id":802,"main":"Clouds","description":"scattered clouds","icon":"03n"}],"pop":0.19},{"dt":1787540400,"temp":24.45,"feels_like":25.35,"pressure":1013,"humidity":92,"dew_point":20.52,"uvi":0,"clouds":37,"visibility":10000,"wind_speed":3.75,"wind_deg":106,"wind_gust":6.8,"weather":[{"id":802,"main":"Clouds","description":"scattered clouds","icon":"03n"}],"pop":0.15},{"dt":1787544000,"temp":24.57,"feels_like":25.51,"pressure":1013,"humidity":93,"dew_point":20.44,"uvi":0,"clouds":40,"visibility":10000,"wind_speed":2.75,"wind_deg":118,"wind_gust":5.31,"weather":[{"id":500,"main":"Rain","description":"light rain","icon":"10n"}],"pop":0.3,"rain":{"1h":0.15}},{"dt":1787547600,"temp":23.55,"feels_like":24.42,"pressure":1013,"humidity":94,"dew_point":20.04,"uvi":0,"clouds":41,"visibility":10000,"wind_speed":2.23,"wind_deg":102,"wind_gust":4.05,"weather":[{"id":500,"main":"Rain","description":"light rain","icon":"10n"}],"pop":0.96,"rain":{"1h":0.64}},{"dt":1787551200,"temp":23.49,"feels_like":24.32,"pressure":1013,"humidity":93,"dew_point":19.81,"uvi":0.13,"clouds":39,"visibility":10000,"wind_speed":2.27,"wind_deg":100,"wind_gust":4.69,"weather":[{"id":500,"main":"Rain","description":"light rain","icon":"10d"}],"pop":0.99,"rain":{"1h":0.39}},{"dt":1787554800,"temp":25.78,"feels_like":26.69,"pressure":1014,"humidity":87,"dew_point":19.88,"uvi":0.61,"clouds":99,"visibility":10000,"wind_speed":2.42,"wind_deg":108,"wind_gust":4.49,"weather":[{"id":500,"main":"Rain","description":"light rain","icon":"10d"}],"pop":1,"rain":{"1h":0.39}},{"dt":1787558400,"temp":26.95,"feels_like":29.45,"pressure":1013,"humidity":78,"dew_point":19.9,"uvi":1.74,"clouds":66,"visibility":10000,"wind_speed":2.94,"wind_deg":117,"wind_gust":3.53,"weather":[{"id":500,"main":"Rain","description":"light rain","icon":"10d"}],"pop":0.97,"rain":{"1h":0.28}},{"dt":1787562000,"temp":29.36,"feels_like":32.36,"pressure":1013,"humidity":64,"dew_point":18.82,"uvi":3.36,"clouds":50,"visibility":10000,"wind_speed":2.71,"wind_deg":138,"wind_gust":3.81,"weather":[{"id":802,"main":"Clouds","description":"scattered clouds","icon":"03d"}],"pop":0.71},{"dt":1787565600,"temp":29.5,"feels_like":30.47,"pressure":1012,"humidity":51,"dew_point":17.11,"uvi":5.22,"clouds":41,"visibility":10000,"wind_speed":2.83,"wind_deg":126,"wind_gust":4.34,"weather":[{"id":500,"main":"Rain","description":"light rain","icon":"10d"}],"pop":0.95,"rain":{"1h":0.47}},{"dt":1787569200,"temp":30.55,"feels_like":30.22,"pressure":1011,"humidity":39,"dew_point":14.92,"uvi":6.54,"clouds":38,"visibility":10000,"wind_speed":2.77,"wind_deg":108,"wind_gust":6.29,"weather":[{"id":802,"main":"Clouds","description":"scattered clouds","icon":"03d"}],"pop":0.73},{"dt":1787572800,"temp":31.56,"feels_like":30.79,"pressure":1010,"humidity":34,"dew_point":12.49,"uvi":6.87,"clouds":40,"visibility":10000,"wind_speed":1.88,"wind_deg":138,"wind_gust":6.78,"weather":[{"id":802,"main":"Clouds","description":"scattered clouds","icon":"03d"}],"pop":0.9},{"dt":1787576400,"temp":32.85,"feels_like":30.94,"pressure":1010,"humidity":22,"dew_point":7.29,"uvi":6.48,"clouds":15,"visibility":10000,"wind_speed":4.2,"wind_deg":212,"wind_gust":8.56,"weather":[{"id":801,"main":"Clouds","description":"few clouds","icon":"02d"}],"pop":0},{"dt":1787580000,"temp":33.29,"feels_like":30.99,"pressure":1010,"humidity":16,"dew_point":4.49,"uvi":3.48,"clouds":50,"visibility":10000,"wind_speed":9.38,"wind_deg":248,"wind_gust":11.87,"weather":[{"id":802,"main":"Clouds","description":"scattered clouds","icon":"03d"}],"pop":0},{"dt":1787583600,"temp":31.94,"feels_like":30.04,"pressure":1010,"humidity":22,"dew_point":7.5,"uvi":3.38,"clouds":55,"visibility":10000,"wind_speed":12,"wind_deg":255,"wind_gust":12.25,"weather":[{"id":803,"main":"Clouds","description":"broken clouds","icon":"04d"}],"pop":0},{"dt":1787587200,"temp":31.64,"feels_like":29.7,"pressure":1010,"humidity":21,"dew_point":7.03,"uvi":1.41,"clouds":49,"visibility":10000,"wind_speed":10.9,"wind_deg":245,"wind_gust":12.35,"weather":[{"id":802,"main":"Clouds","description":"scattered clouds","icon":"03d"}],"pop":0},{"dt":1787590800,"temp":31.46,"feels_like":29.53,"pressure":1010,"humidity":21,"dew_point":6.96,"uvi":0.3,"clouds":40,"visibility":10000,"wind_speed":8.06,"wind_deg":226,"wind_gust":10.78,"weather":[{"id":802,"main":"Clouds","description":"scattered clouds","icon":"03d"}],"pop":0},{"dt":1787594400,"temp":30.61,"feels_like":28.82,"pressure":1009,"humidity":22,"dew_point":6.91,"uvi":0.17,"clouds":45,"visibility":10000,"wind_speed":7.1,"wind_deg":248,"wind_gust":10.22,"weather":[{"id":802,"main":"Clouds","description":"scattered clouds","icon":"03d"}],"pop":0},{"dt":1787598000,"temp":29.18,"feels_like":27.81,"pressure":1010,"humidity":26,"dew_point":7.79,"uvi":0,"clouds":90,"visibility":10000,"wind_speed":7.85,"wind_deg":258,"wind_gust":11.94,"weather":[{"id":804,"main":"Clouds","description":"overcast clouds","icon":"04n"}],"pop":0},{"dt":1787601600,"temp":27.24,"feels_like":26.66,"pressure":1012,"humidity":32,"dew_point":9.14,"uvi":0,"clouds":45,"visibility":10000,"wind_speed":8.95,"wind_deg":257,"wind_gust":14.47,"weather":[{"id":802,"main":"Clouds","description":"scattered clouds","icon":"03n"}],"pop":0},{"dt":1787605200,"temp":26.33,"feels_like":26.33,"pressure":1012,"humidity":36,"dew_point":9.82,"uvi":0,"clouds":28,"visibility":10000,"wind_speed":7.61,"wind_deg":247,"wind_gust":13.17,"weather":[{"id":802,"main":"Clouds","description":"scattered clouds","icon":"03n"}],"pop":0},{"dt":1787608800,"temp":25.61,"feels_like":25.19,"pressure":1013,"humidity":37,"dew_point":9.73,"uvi":0,"clouds":22,"visibility":10000,"wind_speed":7.12,"wind_deg":240,"wind_gust":12.53,"weather":[{"id":801,"main":"Clouds","description":"few clouds","icon":"02n"}],"pop":0},{"dt":1787612400,"temp":25.19,"feels_like":24.78,"pressure":1013,"humidity":39,"dew_point":9.92,"uvi":0,"clouds":34,"visibility":10000,"wind_speed":6.41,"wind_deg":241,"wind_gust":11.65,"weather":[{"id":802,"main":"Clouds","description":"scattered clouds","icon":"03n"}],"pop":0},{"dt":1787616000,"temp":27.25,"feels_like":27.1,"pressure":1013,"humidity":41,"dew_point":10.38,"uvi":0,"clouds":45,"visibility":10000,"wind_speed":7.01,"wind_deg":237,"wind_gust":12.6,"weather":[{"id":802,"main":"Clouds","description":"scattered clouds","icon":"03n"}],"pop":0},{"dt":1787619600,"temp":25.08,"feels_like":24.74,"pressure":1012,"humidity":42,"dew_point":10.85,"uvi":0,"clouds":98,"visibility":10000,"wind_speed":7.62,"wind_deg":244,"wind_gust":12.9,"weather":[{"id":804,"main":"Clouds","description":"overcast clouds","icon":"04n"}],"pop":0},{"dt":1787623200,"temp":24.99,"feels_like":24.67,"pressure":1012,"humidity":43,"dew_point":10.94,"uvi":0,"clouds":99,"visibility":10000,"wind_speed":6.86,"wind_deg":249,"wind_gust":13,"weather":[{"id":804,"main":"Clouds","description":"overcast clouds","icon":"04n"}],"pop":0},{"dt":1787626800,"temp":24.53,"feels_like":24.16,"pressure":1012,"humidity":43,"dew_point":10.87,"uvi":0,"clouds":99,"visibility":10000,"wind_speed":6.44,"wind_deg":248,"wind_gust":12.58,"weather":[{"id":804,"main":"Clouds","description":"overcast clouds","icon":"04n"}],"pop":0},{"dt":1787630400,"temp":24,"feels_like":23.6,"pressure":1012,"humidity":44,"dew_point":10.77,"uvi":0,"clouds":100,"visibility":10000,"wind_speed":5.35,"wind_deg":251,"wind_gust":10.33,"weather":[{"id":804,"main":"Clouds","description":"overcast clouds","icon":"04n"}],"pop":0},{"dt":1787634000,"temp":23.43,"feels_like":23.03,"pressure":1012,"humidity":46,"dew_point":10.75,"uvi":0,"clouds":99,"visibility":10000,"wind_speed":4.59,"wind_deg":245,"wind_gust":7.78,"weather":[{"id":804,"main":"Clouds","description":"overcast clouds","icon":"04n"}],"pop":0},{"dt":1787637600,"temp":23.69,"feels_like":23.32,"pressure":1012,"humidity":46,"dew_point":11.03,"uvi":0.12,"clouds":100,"visibility":10000,"wind_speed":4.61,"wind_deg":247,"wind_gust":7.74,"weather":[{"id":804,"main":"Clouds","description":"overcast clouds","icon":"04d"}],"pop":0},{"dt":1787641200,"temp":24.48,"feels_like":24.16,"pressure":1013,"humidity":45,"dew_point":11.26,"uvi":0.63,"clouds":100,"visibility":10000,"wind_speed":5.31,"wind_deg":253,"wind_gust":7.49,"weather":[{"id":804,"main":"Clouds","description":"overcast clouds","icon":"04d"}],"pop":0},{"dt":1787644800,"temp":25.48,"feels_like":25.21,"pressure":1013,"humidity":43,"dew_point":11.55,"uvi":1.76,"clouds":100,"visibility":10000,"wind_speed":6.71,"wind_deg":253,"wind_gust":8.45,"weather":[{"id":804,"main":"Clouds","description":"overcast clouds","icon":"04d"}],"pop":0},{"dt":1787648400,"temp":26.65,"feels_like":26.65,"pressure":1013,"humidity":41,"dew_point":11.96,"uvi":3.37,"clouds":100,"visibility":10000,"wind_speed":7.96,"wind_deg":248,"wind_gust":8.52,"weather":[{"id":804,"main":"Clouds","description":"overcast clouds","icon":"04d"}],"pop":0}],"daily":[{"dt":1787486400,"sunrise":1787462415,"sunset":1787511159,"moonrise":1787502480,"moonset":1787443920,"moon_phase":0.35,"summary":"Expect a day of partly cloudy with rain","temp":{"day":29.52,"min":22.33,"max":32.57,"night":23.29,"eve":25.77,"morn":23.15},"feels_like":{"day":29.96,"night":23.24,"eve":25.94,"morn":23.48},"pressure":1016,"humidity":47,"dew_point":17.03,"wind_speed":12.02,"wind_deg":65,"wind_gust":17.4,"weather":[{"id":501,"main":"Rain","description":"moderate rain","icon":"10d"}],"clouds":16,"pop":1,"rain":4.51,"uvi":7.49},{"dt":1787572800,"sunrise":1787548876,"sunset":1787597466,"moonrise":1787591220,"moonset":1787533860,"moon_phase":0.38,"summary":"Expect a day of partly cloudy with rain","temp":{"day":31.56,"min":23.13,"max":33.29,"night":26.33,"eve":30.61,"morn":23.49},"feels_like":{"day":30.79,"night":26.33,"eve":28.82,"morn":24.32},"pressure":1010,"humidity":34,"dew_point":12.49,"wind_speed":12,"wind_deg":255,"wind_gust":14.47,"weather":[{"id":500,"main":"Rain","description":"light rain","icon":"10d"}],"clouds":40,"pop":1,"rain":2.8,"uvi":6.87},{"dt":1787659200,"sunrise":1787635338,"sunset":1787683772,"moonrise":1787679540,"moonset":1787624040,"moon_phase":0.41,"summary":"Expect a day of partly cloudy with clear spells","temp":{"day":29.93,"min":23.43,"max":32.76,"night":27.31,"eve":31.29,"morn":23.69},"feels_like":{"day":28.84,"night":26.94,"eve":29.77,"morn":23.32},"pressure":1013,"humidity":32,"dew_point":11.31,"wind_speed":7.96,"wind_deg":248,"wind_gust":13,"weather":[{"id":803,"main":"Clouds","description":"broken clouds","icon":"04d"}],"clouds":84,"pop":0,"uvi":7.82},{"dt":1787745600,"sunrise":1787721800,"sunset":1787770077,"moonrise":1787767560,"moonset":1787714400,"moon_phase":0.44,"summary":"There will be clear sky until morning, then partly cloudy","temp":{"day":32.15,"min":23.35,"max":36.21,"night":27.14,"eve":32.66,"morn":23.51},"feels_like":{"day":30.87,"night":26.68,"eve":30.61,"morn":23.3},"pressure":1009,"humidity":29,"dew_point":11.86,"wind_speed":8.49,"wind_deg":265,"wind_gust":12.32,"weather":[{"id":804,"main":"Clouds","description":"overcast clouds","icon":"04d"}],"clouds":100,"pop":0,"uvi":7.39},{"dt":1787832000,"sunrise":1787808262,"sunset":1787856382,"moonrise":1787855340,"moonset":1787804760,"moon_phase":0.48,"summary":"There will be partly cloudy today","temp":{"day":29.49,"min":20.75,"max":30.3,"night":20.75,"eve":27.1,"morn":22.69},"feels_like":{"day":27.74,"night":19.87,"eve":26.27,"morn":22.19},"pressure":1011,"humidity":15,"dew_point":-0.39,"wind_speed":11.67,"wind_deg":281,"wind_gust":13.22,"weather":[{"id":804,"main":"Clouds","description":"overcast clouds","icon":"04d"}],"clouds":100,"pop":0,"uvi":5.53},{"dt":1787918400,"sunrise":1787894723,"sunset":1787942686,"moonrise":1787943060,"moonset":1787895180,"moon_phase":0.5,"summary":"Expect a day of partly cloudy with clear spells","temp":{"day":25.23,"min":15.81,"max":27.76,"night":22.04,"eve":26.12,"morn":15.81},"feels_like":{"day":24.44,"night":21.19,"eve":26.12,"morn":14.8},"pressure":1019,"humidity":24,"dew_point":2.64,"wind_speed":5.2,"wind_deg":259,"wind_gust":7.86,"weather":[{"id":802,"main":"Clouds","description":"scattered clouds","icon":"03d"}],"clouds":25,"pop":0,"uvi":6},{"dt":1788004800,"sunrise":1787981184,"sunset":1788028989,"moonrise":1788030720,"moonset":1787985600,"moon_phase":0.54,"summary":"Expect a day of partly cloudy with clear spells","temp":{"day":27.25,"min":16.46,"max":30.26,"night":25.07,"eve":28.98,"morn":16.46},"feels_like":{"day":26.46,"night":24.39,"eve":27.47,"morn":16.04},"pressure":1017,"humidity":27,"dew_point":6.26,"wind_speed":3.18,"wind_deg":43,"wind_gust":2.77,"weather":[{"id":800,"main":"Clear","description":"clear sky","icon":"01d"}],"clouds":6,"pop":0,"uvi":6},{"dt":1788091200,"sunrise":1788067646,"sunset":1788115291,"moonrise":1788118380,"moonset":1788076080,"moon_phase":0.58,"summary":"Expect a day of partly cloudy with clear spells","temp":{"day":28.9,"min":18.56,"max":32.64,"night":27.03,"eve":31.95,"morn":18.56},"feels_like":{"day":28.69,"night":28.34,"eve":30.65,"morn":18.33},"pressure":1015,"humidity":42,"dew_point":14.19,"wind_speed":3.65,"wind_deg":110,"wind_gust":7.29,"weather":[{"id":801,"main":"Clouds","description":"few clouds","icon":"02d"}],"clouds":18,"pop":0,"uvi":6}],"alerts":[{"sender_name":"AEMET. Agencia Estatal de Meteorología","event":"Moderate thunderstorm warning","start":1787565600,"end":1787608799,"description":"Pueden ir acompañadas de granizo y rachas muy fuertes de viento.","tags":["Thunderstorm"]},{"sender_name":"AEMET. Agencia Estatal de Meteorología","event":"Severe thunderstorm warning","start":1787486400,"end":1787515199,"description":"Pueden ir acompañadas de granizo superior a 2 cm y rachas muy fuertes de viento.","tags":["Thunderstorm"]},{"sender_name":"AEMET. Agencia Estatal de Meteorología","event":"Moderate rain warning","start":1787565600,"end":1787608799,"description":"One-hour accumulated precipitation: 20 mm.","tags":["Rain"]}]})JSON";
